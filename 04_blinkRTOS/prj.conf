## CMakeLists.txt
```
# SPDX-License-Identifier: Apache-2.0

cmake_minimum_required(VERSION 3.20.0)
find_package(Zephyr REQUIRED HINTS $ENV{ZEPHYR_BASE})
project(blinkyRTOS)

target_sources(app PRIVATE
        src/main.c
        src/blinky.c)
```

## prj.conf
```kconfig
CONFIG_GPIO=y
CONFIG_INIT_STACKS=y
CONFIG_THREAD_MONITOR=y
CONFIG_THREAD_STACK_INFO=y
CONFIG_KERNEL_SHELL=y
CONFIG_SHELL=y
```

## boards/nrf7002dk_nrf5340_cpuapp.overlay
```dts
/ {
	aliases {
		training-led = &led2_subnode_label;
	};


	led_childnode: led_childnode_path {
		compatible = "gpio-leds";

		led2_subnode_label: led2_path {
			gpios = <&gpio1 7 GPIO_ACTIVE_HIGH>;
		};
	};
};
```

## src/main.c
```c
/*
 * Copyright (c) 2016 Intel Corporation
 *
 * SPDX-License-Identifier: Apache-2.0
 */

#include <zephyr/kernel.h>
#include <zephyr/drivers/gpio.h>
#include "blinky.h"

#define STACK_SIZE 256
#define PRIORITY 5
#define NUM_THREADS 2

K_THREAD_STACK_ARRAY_DEFINE(thread_stacks, NUM_THREADS, STACK_SIZE);
struct k_thread thread_data[2];

/* 1000 msec = 1 sec */
#define SLEEP_TIME_MS0   1000
#define SLEEP_TIME_MS1   900

/* The devicetree node identifier for the "training_led" alias. */
#define LED0_NODE DT_ALIAS(led_a)
#define LED1_NODE DT_ALIAS(led_b)

static const struct gpio_dt_spec led0 = GPIO_DT_SPEC_GET(LED0_NODE, gpios);
static const struct gpio_dt_spec led1 = GPIO_DT_SPEC_GET(LED1_NODE, gpios);

/* Main function */
int main(void)
{
	k_thread_create(
		&thread_data[0],
		thread_stacks[0],
		STACK_SIZE,
		blinky,
		(void *)&led0,
		(void *)1000,
		NULL,
		K_LOWEST_APPLICATION_THREAD_PRIO,
		0,
		K_NO_WAIT);

	k_thread_name_set(&thread_data[0], "blinky0");

	k_thread_create(
			&thread_data[1],
			thread_stacks[1],
			STACK_SIZE,
			blinky,
			(void *)&led1,
			(void *)950,
			NULL,
			K_LOWEST_APPLICATION_THREAD_PRIO,
			0,
			K_NO_WAIT);

	k_thread_name_set(&thread_data[1], "blinky1");

	k_yield();
}
```

## src/blinky.c
```c
#include <zephyr/kernel.h>
#include <zephyr/drivers/gpio.h>

K_MUTEX_DEFINE(led_mutex);

extern void blinky(void *p1, void *p2, void *p3)
{
    struct gpio_dt_spec *led = (struct gpio_dt_spec *)p1;
    int period = (int)p2;
    int ret = 0;
    uint32_t count=0;

    if (!device_is_ready(led->port)) {
        return;
    }

    ret = gpio_pin_configure_dt(led, GPIO_OUTPUT_ACTIVE);
    if (ret < 0) {
        return;
    }

    while (1) {
        if (k_mutex_lock(&led_mutex, K_MSEC(5)) == 0) {
            gpio_pin_toggle_dt(led);
            count++;
            k_mutex_unlock(&led_mutex);
        }
        k_msleep(period);
    }
}
```

## src/blinky.h
```c
#ifndef __BLINKY_H__
#define __BLINKY_H__

extern void blinky(void *p1, void *p2, void *p3);

#endif
```
